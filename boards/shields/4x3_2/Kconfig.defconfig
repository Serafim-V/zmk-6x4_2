## boards/shields/4x3_2/Kconfig.defconfig
```kconfig
if SHIELD_4x3_2_LEFT

config ZMK_KEYBOARD_NAME
    default "My Board"

config ZMK_SPLIT_ROLE_CENTRAL
    default y

endif

if SHIELD_4x3_2_LEFT || SHIELD_4x3_2_RIGHT

config ZMK_SPLIT
    default y

endif
```

## boards/shields/4x3_2/Kconfig.shield
```kconfig
config SHIELD_4x3_2_LEFT
    def_bool $(shields_list_contains,4x3_2_left)

config SHIELD_4x3_2_RIGHT
    def_bool $(shields_list_contains,4x3_2_right)
```

## boards/shields/6x3_2/Kconfig.shield
```kconfig
config SHIELD_6x3_2_LEFT
    def_bool $(shields_list_contains,6x3_2_left)

config SHIELD_6x3_2_RIGHT
    def_bool $(shields_list_contains,6x3_2_right)
```

## boards/shields/6x4_2/Kconfig.defconfig
```kconfig
if SHIELD_6x4_2_LEFT

config ZMK_KEYBOARD_NAME
    default "My Board"

config ZMK_SPLIT_ROLE_CENTRAL
    default y

endif

if SHIELD_6x4_2_LEFT || SHIELD_6x4_2_RIGHT

config ZMK_SPLIT
    default y

endif
```

## boards/shields/6x4_2/Kconfig.shield
```kconfig
config SHIELD_6x4_2_LEFT
    def_bool $(shields_list_contains,6x4_2_left)

config SHIELD_6x4_2_RIGHT
    def_bool $(shields_list_contains,6x4_2_right)
```
